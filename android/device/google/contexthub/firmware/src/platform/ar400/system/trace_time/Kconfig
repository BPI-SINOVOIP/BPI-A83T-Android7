## android/device/google/contexthub/firmware/src/platform/ar400/system/trace_time/Kconfig
```kconfig
#
# sunxi time trace configuration.
#

config SUNXI_TIME_TRACE
	tristate "sunxi time trace driver"
	default n
	help
	Nothing help.
```
